#include <Nokia_LCD.h>
#include <SPI.h>
#include <Adafruit_GFX.h>
#include <Adafruit_PCD8544.h>  

#define PIN_RESET 12          
#define PIN_SCE   11     
#define PIN_DC    10
#define PIN_SDIN  9
#define PIN_SCLK  8                                            
#define LCD_C     LOW 
#define LCD_D     HIGH
#define LCD_X     84   //tamaño de la matriz
#define LCD_Y     48
int p[]={
0x00, 0x00, 0x00, 0x00, 0x00, 0x00, 0x00, 0x00, 0x00, 0x00, 0x00, 0x00, 0x00, 0x00, 0x00, 0x00,
0x00, 0x00, 0x00, 0x00, 0x00, 0x00, 0xC0, 0xE0, 0x20, 0x20, 0x20, 0x20, 0x60, 0x40, 0xC0, 0x80,
0x80, 0x00, 0x00, 0x00, 0x00, 0x00, 0x00, 0x00, 0x00, 0x00, 0x00, 0x00, 0x00, 0x00, 0x00, 0x00,
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0x0F, 0xF7, 0x9D, 0x84, 0x80, 0x80, 0x00, 0x00, 0x00, 0x00, 0x00, 0x00, 0x00, 0x00, 0x00, 0x20,};

void LcdClear(void)
{
  for (int index = 0; index < LCD_X * LCD_Y / 8; index++)
  {
    LcdWrite(LCD_D, 0x00);// para empezar a escribir en toda la pantalla
  }
}

void LcdInitialise(void)
{                                    //empezar a dibjar en la pantalla
  pinMode(PIN_SCE, OUTPUT);   
  pinMode(PIN_RESET, OUTPUT);
  pinMode(PIN_DC, OUTPUT);
  pinMode(PIN_SDIN, OUTPUT);
  pinMode(PIN_SCLK, OUTPUT);
  digitalWrite(PIN_RESET, LOW);  moverse 
  digitalWrite(PIN_RESET, HIGH);
  LcdWrite(LCD_C, 0x21 );
  LcdWrite(LCD_C, 0xB1 );
  LcdWrite(LCD_C, 0x04 );
  LcdWrite(LCD_C, 0x14 );    //que pines iran iluminados
  LcdWrite(LCD_C, 0x0C );
  LcdWrite(LCD_C, 0x20 );
  LcdWrite(LCD_C, 0x0C );
}
void gotoXY(int x, int y)
{
  LcdWrite (0, 0x84 | x);          //recorrer la pantalla
  LcdWrite (0, 0x48 | y);
}
void LcdWrite(byte dc, byte data)
{
  digitalWrite(PIN_DC, dc);
  digitalWrite(PIN_SCE, LOW);
  shiftOut(PIN_SDIN, PIN_SCLK, MSBFIRST, data);
  digitalWrite(PIN_SCE, HIGH);
}

void LcdBitmap(int my_array[]){
  for (int index = 0; index < (LCD_X * LCD_Y/8); index++)    //coordenadas
  LcdWrite(LCD_D, my_array[index]);
  }
void setup(void)
{
  LcdInitialise(); inicia el lcd 
  LcdClear();    limpia la pantalla 
  gotoXY(0,0);
}
void loop(void)
{
  LcdBitmap(p);   //mapa de bits de la pantalla 
  while (p)
  {
  }
}
